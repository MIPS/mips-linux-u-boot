## arch/mips/cmd/Kconfig
```kconfig
menu "MIPS-specific commands"
	depends on MIPS

config CMD_COP
	bool "Coprocessor control register access"
	default y if TARGET_BOSTON || TARGET_MALTA || TARGET_SEAD_3
	help
	  Allows access to coprocessor control registers, notably those in
	  coprocessor 0 which provide information about & control of much of
	  the system. Access to such registers can be very useful for debugging
	  purposes or to make an adjustment as part of a quick test during
	  development. Please beware that one can cause the system to become
	  unstable by modifying coprocessor register values, so this command
	  should be used with care.

endmenu
```

## board/imgtec/sead-3/Kconfig
```kconfig
if TARGET_SEAD_3

config SYS_BOARD
	default "sead-3"

config SYS_VENDOR
	default "imgtec"

config SYS_CONFIG_NAME
	default "sead-3"

config SYS_TEXT_BASE
	default 0x9fc00000

endif
```

## board/imgtec/sead3/Kconfig
```kconfig
if TARGET_SEAD3

config SYS_BOARD
	default "sead3"

config SYS_VENDOR
	default "imgtec"

config SYS_CONFIG_NAME
	default "sead3"

config SYS_TEXT_BASE
	default 0x9fc00000

endif
```

## configs/boston32r2_defconfig
```kconfig
CONFIG_MIPS=y
CONFIG_TARGET_BOSTON=y
# CONFIG_MIPS_BOOT_CMDLINE_LEGACY is not set
# CONFIG_MIPS_BOOT_ENV_LEGACY is not set
CONFIG_MIPS_BOOT_FDT=y
CONFIG_MIPS_UHI=y
CONFIG_DEFAULT_DEVICE_TREE="img,boston"
CONFIG_AHCI=y
CONFIG_DISTRO_DEFAULTS=y
CONFIG_FIT=y
CONFIG_FIT_VERBOSE=y
CONFIG_FIT_BEST_MATCH=y
CONFIG_OF_STDOUT_VIA_ALIAS=y
CONFIG_SYS_PROMPT="boston # "
# CONFIG_CMD_ELF is not set
CONFIG_CMD_GREPENV=y
CONFIG_CMD_MEMTEST=y
# CONFIG_CMD_FPGA is not set
# CONFIG_CMD_LOADB is not set
# CONFIG_CMD_LOADS is not set
CONFIG_CMD_MMC=y
CONFIG_CMD_PCI=y
CONFIG_CMD_SATA=y
CONFIG_CMD_SNTP=y
CONFIG_CMD_DNS=y
CONFIG_CMD_LINK_LOCAL=y
CONFIG_CMD_TIME=y
CONFIG_CMD_EXT4_WRITE=y
CONFIG_PARTITION_TYPE_GUID=y
CONFIG_OF_EMBED=y
CONFIG_ENV_IS_IN_FLASH=y
CONFIG_NET_RANDOM_ETHADDR=y
CONFIG_AHCI_PCI=y
CONFIG_BLOCK_CACHE=y
CONFIG_CLK=y
CONFIG_CPU=y
CONFIG_EG20T_GPIO=y
CONFIG_MMC=y
CONFIG_DM_MMC=y
CONFIG_MMC_PCI=y
CONFIG_MMC_SDHCI=y
CONFIG_MMC_SDHCI_SDMA=y
CONFIG_MTD=y
CONFIG_MTD_NOR_FLASH=y
CONFIG_CFI_FLASH=y
CONFIG_DM_ETH=y
CONFIG_PCH_GBE=y
CONFIG_PCI=y
CONFIG_DM_PCI=y
CONFIG_DM_PCI_BRIDGE_MEM_ALIGN=0x0
CONFIG_PCI_XILINX=y
CONFIG_SCSI=y
CONFIG_DM_SCSI=y
CONFIG_SYS_NS16550=y
CONFIG_LZ4=y
```

## configs/malta32r6el_defconfig
```kconfig
CONFIG_MIPS=y
CONFIG_TARGET_MALTA=y
CONFIG_SYS_LITTLE_ENDIAN=y
CONFIG_CPU_MIPS32_R6=y
CONFIG_DEFAULT_DEVICE_TREE="mti,malta"
CONFIG_FIT=y
CONFIG_FIT_VERBOSE=y
CONFIG_BOOTDELAY=-1
CONFIG_SYS_PROMPT="maltael # "
# CONFIG_AUTOBOOT is not set
# CONFIG_CMD_LOADB is not set
# CONFIG_CMD_LOADS is not set
# CONFIG_CMD_FPGA is not set
# CONFIG_CMD_SETEXPR is not set
# CONFIG_CMD_NFS is not set
CONFIG_OF_EMBED=y
CONFIG_PCI=y
CONFIG_SYS_NS16550=y
```

## configs/sead3_defconfig
```kconfig
CONFIG_MIPS=y
CONFIG_TARGET_SEAD3=y
CONFIG_SYS_LITTLE_ENDIAN=y
CONFIG_DEFAULT_DEVICE_TREE="mti,sead3"
CONFIG_FIT=y
CONFIG_FIT_VERBOSE=y
CONFIG_HUSH_PARSER=y
CONFIG_SYS_PROMPT="sead3 # "
CONFIG_CMD_CPU=y
# CONFIG_CMD_IMLS is not set
CONFIG_CMD_FITUPD=y
CONFIG_OF_CONTROL=y
CONFIG_OF_EMBED=y
CONFIG_CPU=y
CONFIG_USB=y
CONFIG_DM_USB=y
CONFIG_USB_EHCI_HCD=y
CONFIG_USB_EHCI_GENERIC=y
CONFIG_USB_STORAGE=y
CONFIG_OF_LIBFDT_OVERLAY=y
```

## configs/sead_3_defconfig
```kconfig
CONFIG_MIPS=y
CONFIG_TARGET_SEAD_3=y
CONFIG_SYS_LITTLE_ENDIAN=y
CONFIG_CPU_MIPS32_R6=y
CONFIG_DEFAULT_DEVICE_TREE="mti,sead-3"
CONFIG_FIT=y
CONFIG_FIT_VERBOSE=y
# CONFIG_ARCH_FIXUP_FDT_MEMORY is not set
# CONFIG_DISPLAY_BOARDINFO is not set
CONFIG_HUSH_PARSER=y
CONFIG_SYS_PROMPT="sead-3 # "
# CONFIG_AUTOBOOT is not set
CONFIG_CMD_CONFIG=y
# CONFIG_CMD_FLASH is not set
# CONFIG_CMD_FPGA is not set
# CONFIG_CMD_LOADB is not set
# CONFIG_CMD_LOADS is not set
CONFIG_CMD_DHCP=y
# CONFIG_CMD_NFS is not set
CONFIG_CMD_PING=y
# CONFIG_PARTITIONS is not set
CONFIG_OF_LIVE=y
CONFIG_OF_EMBED=y
CONFIG_NET_RANDOM_ETHADDR=y
CONFIG_MTD_NOR_FLASH=y
CONFIG_DM_ETH=y
CONFIG_SMC911X=y
CONFIG_SYS_NS16550=y
```

## drivers/lcd/Kconfig
```kconfig
menu "LCD Support"

config DM_LCD
	bool "Enable LCD support"
	depends on DM
	help
	  Enable this to provide support for simple LCD displays commonly used
	  to display simple messages in order to provide feedback to the user.

endmenu
```
